// Copyright (c) 2024 Nordic Semiconductor ASA
// SPDX-License-Identifier: Apache-2.0

/dts-v1/;
#include <nordic/nrf52832_qfaa.dtsi>

/ {
	model = "IoT Energy Harvesting Main System";
	compatible = "ntnu,iot-energy-harvesting-main-system";

	chosen {
		zephyr,sram = &sram0;
		zephyr,flash = &flash0;
		zephyr,code-partition = &slot0_partition;
	};

	leds {
		compatible = "nordic,gpio-pins";
		led1: led_1{
            gpios = <&gpio0  9 GPIO_ACTIVE_LOW>;
			label = "LED 1";
		};
		led2: led_2{
            gpios = <&gpio0  10 GPIO_ACTIVE_LOW>;
			label = "LED 2";
		};
	};
};

&flash0 {
	partitions {
		compatible = "fixed-partitions";
		#address-cells = <1>;
		#size-cells = <1>;

		boot_partition: partition@0 {
			label = "mcuboot";
			reg = <0x0 0xc000>;
		};
		slot0_partition: partition@c000 {
			label = "image-0";
			reg = <0xc000 0x32000>;
		};
		slot1_partition: partition@3e000 {
			label = "image-1";
			reg = <0x3e000 0x32000>;
		};
		scratch_partition: partition@70000 {
			label = "image-scratch";
			reg = <0x70000 0xa000>;
		};
		storage_partition: partition@7a000 {
			label = "storage";
			reg = <0x7a000 0x6000>;
		};
	};
};



clock@40000000

&timer0 {
	status = "disabled";
};

&timer1 {
	status = "disabled";
};

&timer2 {
	status = "disabled";
};

&i2c0 {
	status = "disabled";
};

&clock {
	reg = <0x40000000 0x1000>;
	status = "okay";
};

aliases {
	led_1 = &led1;
	led_2 = &led2;
};