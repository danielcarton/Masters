## Energy_harvester_iot/Code/boards/arm/iot_energy_harvesting_main_system/Kconfig.board
```kconfig
# Copyright (c) 2024 Nordic Semiconductor ASA
# SPDX-License-Identifier: Apache-2.0

config BOARD_IOT_ENERGY_HARVESTING_MAIN_SYSTEM
	bool "IoT Energy Harvesting Main System"
	depends on SOC_NRF52832_QFAA
```

## Energy_harvester_iot/Code/temp/iot_energy_harvesting_main_system/Kconfig.defconfig
```kconfig
# Copyright (c) 2024 Nordic Semiconductor ASA
# SPDX-License-Identifier: Apache-2.0

if BOARD_IOT_ENERGY_HARVESTING_MAIN_SYSTEM

config BOARD
	default "iot_energy_harvesting_main_system"

config BT_CTLR
   default BT


endif
```

## Energy_harvester_iot/boards/arm/iot_energy_harvesting_main_system/Kconfig.board
```kconfig
# Copyright (c) 2024 Nordic Semiconductor ASA
# SPDX-License-Identifier: Apache-2.0

config BOARD_IOT_ENERGY_HARVESTING_MAIN_SYSTEM
	bool "Iot_energy_harvesting_main_system"
	depends on SOC_NRF52832_QFAA
```
